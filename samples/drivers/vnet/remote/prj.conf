## CMakeLists.txt
```
#
# Copyright (c) 2021 Carlo Caione <ccaione@baylibre.com>
# Copyright 2023-2026 NXP
# Copyright 2025 Ezurio LLC
#
# SPDX-License-Identifier: Apache-2.0
#

cmake_minimum_required(VERSION 3.20.0)

find_package(Zephyr REQUIRED HINTS $ENV{ZEPHYR_BASE})

if(CONFIG_BOARD_MIMXRT1180_EVK_MIMXRT1189_CM7 OR
   CONFIG_BOARD_FRDM_MCXN947_MCXN947_CPU1 OR
   CONFIG_BOARD_MCX_N9XX_EVK_MCXN947_CPU1)
  message(STATUS "${BOARD}/${BOARD_QUALIFIERS} compile as remote in this sample")

else()
  message(FATAL_ERROR "${BOARD}/${BOARD_QUALIFIERS} is not supported for this sample")
endif()

project(mbox_ipc_remote)

target_sources(app PRIVATE src/main.c)

# The virtual Ethernet link is now provided by the in-tree
# zephyr,ipc-ethernet driver (drivers/ethernet/eth_ipc.c), enabled from the
# vnet0 devicetree node. The sample only builds the UDP demo on top of it.
if(CONFIG_VNET)
  target_sources(app PRIVATE
    ${CMAKE_CURRENT_SOURCE_DIR}/../common/vnet_demo.c)
  target_include_directories(app PRIVATE ${CMAKE_CURRENT_SOURCE_DIR}/../common)
endif()
```

## Kconfig
```
# Copyright 2024 Nordic Semiconductor ASA
# SPDX-License-Identifier: Apache-2.0

source "Kconfig.zephyr"
rsource "../common/Kconfig.vnet"

config TX_ENABLED
	bool "TX enabled"
	default y
	help
	  Enable TX

config RX_ENABLED
	bool "RX enabled"
	default y
	help
	  Enable RX
```

## prj.conf
```kconfig
CONFIG_MBOX=y

# The virtual Ethernet link is provided by the in-tree zephyr,ipc-ethernet
# driver (CONFIG_ETH_IPC), instantiated from the vnet0 devicetree node in each
# board overlay. The driver role, shared-block address, mailbox channels, plus
# the full network stack are configured per-board under remote/boards/.
```

## boards/frdm_mcxn947_mcxn947_cpu1.conf
```kconfig
CONFIG_SECOND_CORE_MCUX=y

# Virtual Ethernet over shared memory + MBOX doorbell, provided by the in-tree
# zephyr,ipc-ethernet driver (CONFIG_ETH_IPC). This core (cpu1) is the
# "remote": the role, shared-block address and mailbox channels come from the
# vnet0 devicetree node in the board overlay.
CONFIG_ETH_IPC=y

# Sample UDP demo on top of vnet0.
CONFIG_VNET=y
# Send the demo datagrams to BOTH the host core (cpu0, 192.0.2.2) over the
# shared-memory ring AND the off-chip PC (192.0.2.10, reachable via the host
# core's vnet0<->Ethernet bridge). This makes cpu1 a full endpoint that talks
# to both of the other two peers each cycle.
CONFIG_VNET_DEMO_PEER_ADDR="192.0.2.2,192.0.2.10"

CONFIG_MBOX=y

# Console on cpu1.
CONFIG_STDOUT_CONSOLE=y
CONFIG_CONSOLE=y
CONFIG_UART_CONSOLE=y

# Logging: synchronous so the vnet driver messages print immediately.
CONFIG_LOG=y
CONFIG_LOG_MODE_IMMEDIATE=y
CONFIG_LOG_DEFAULT_LEVEL=3
CONFIG_PRINTK=y

# Network stack: IPv4 + UDP sockets.
CONFIG_NETWORKING=y
CONFIG_NET_L2_ETHERNET=y
CONFIG_NET_IPV4=y
CONFIG_NET_IPV6=n
CONFIG_NET_UDP=y
CONFIG_NET_TCP=n
CONFIG_NET_SOCKETS=y
CONFIG_NET_CONFIG_SETTINGS=y
CONFIG_NET_CONFIG_NEED_IPV4=y
CONFIG_NET_CONFIG_MY_IPV4_ADDR="192.0.2.1"
CONFIG_NET_CONFIG_MY_IPV4_NETMASK="255.255.255.0"

CONFIG_NET_PKT_RX_COUNT=8
CONFIG_NET_PKT_TX_COUNT=8
CONFIG_NET_BUF_RX_COUNT=16
CONFIG_NET_BUF_TX_COUNT=16

CONFIG_NET_ARP=y
CONFIG_MAIN_STACK_SIZE=4096

# Allow multiple IPv4-capable interfaces so the address can be placed on vnet0.
CONFIG_NET_IF_MAX_IPV4_COUNT=4
CONFIG_NET_IF_UNICAST_IPV4_ADDR_COUNT=4

# The net stack needs a source of randomness (ephemeral ports, etc).
CONFIG_TEST_RANDOM_GENERATOR=y

# vnet demo: bind socket to vnet0 explicitly.
CONFIG_NET_INTERFACE_NAME=y
CONFIG_NET_SOCKETS_SOCKOPT_TLS=n
CONFIG_NET_IPV4_ACD=n
```

## boards/mcx_n9xx_evk_mcxn947_cpu1.conf
```kconfig
CONFIG_SECOND_CORE_MCUX=y

# Virtual Ethernet over shared memory + MBOX doorbell, provided by the in-tree
# zephyr,ipc-ethernet driver (CONFIG_ETH_IPC). This core (cpu1) is the
# "remote": the role, shared-block address and mailbox channels come from the
# vnet0 devicetree node in the board overlay.
CONFIG_ETH_IPC=y

# Sample UDP demo on top of vnet0.
CONFIG_VNET=y
# Send the demo datagrams off-chip to the PC (reachable via the host core's
# vnet0<->Ethernet bridge) instead of to the host core. Set to "192.0.2.2" to
# target the host core directly instead.
CONFIG_VNET_DEMO_PEER_ADDR="192.0.2.10"

CONFIG_MBOX=y

# Console on cpu1.
CONFIG_STDOUT_CONSOLE=y
CONFIG_CONSOLE=y
CONFIG_UART_CONSOLE=y

# Logging: synchronous so the vnet driver messages print immediately.
CONFIG_LOG=y
CONFIG_LOG_MODE_IMMEDIATE=y
CONFIG_LOG_DEFAULT_LEVEL=3
CONFIG_PRINTK=y

# Network stack: IPv4 + UDP sockets.
CONFIG_NETWORKING=y
CONFIG_NET_L2_ETHERNET=y
CONFIG_NET_IPV4=y
CONFIG_NET_IPV6=n
CONFIG_NET_UDP=y
CONFIG_NET_TCP=n
CONFIG_NET_SOCKETS=y
CONFIG_NET_CONFIG_SETTINGS=y
CONFIG_NET_CONFIG_NEED_IPV4=y
CONFIG_NET_CONFIG_MY_IPV4_ADDR="192.0.2.1"
CONFIG_NET_CONFIG_MY_IPV4_NETMASK="255.255.255.0"

CONFIG_NET_PKT_RX_COUNT=8
CONFIG_NET_PKT_TX_COUNT=8
CONFIG_NET_BUF_RX_COUNT=16
CONFIG_NET_BUF_TX_COUNT=16

CONFIG_NET_ARP=y
CONFIG_MAIN_STACK_SIZE=4096

# Allow multiple IPv4-capable interfaces so the address can be placed on vnet0.
CONFIG_NET_IF_MAX_IPV4_COUNT=4
CONFIG_NET_IF_UNICAST_IPV4_ADDR_COUNT=4

# The net stack needs a source of randomness (ephemeral ports, etc).
CONFIG_TEST_RANDOM_GENERATOR=y

# vnet demo: bind socket to vnet0 explicitly.
CONFIG_NET_INTERFACE_NAME=y
CONFIG_NET_SOCKETS_SOCKOPT_TLS=n
CONFIG_NET_IPV4_ACD=n
```

## boards/mimxrt1180_evk_mimxrt1189_cm7.conf
```kconfig
CONFIG_BUILD_OUTPUT_HEX=y
CONFIG_SECOND_CORE_MCUX=y

# Virtual Ethernet over shared memory + MBOX doorbell, provided by the in-tree
# zephyr,ipc-ethernet driver (CONFIG_ETH_IPC). This core (CM7) is the
# "remote": the role, shared-block address and mailbox channels come from the
# vnet0 devicetree node in the board overlay.
CONFIG_ETH_IPC=y

# Sample UDP demo on top of vnet0.
CONFIG_VNET=y

CONFIG_MBOX=y

# Console on the CM7.
CONFIG_STDOUT_CONSOLE=y
CONFIG_CONSOLE=y
CONFIG_UART_CONSOLE=y

# Logging: enable so the vnet driver LOG_INF/LOG_WRN messages are printed.
CONFIG_LOG=y
CONFIG_LOG_MODE_IMMEDIATE=y
CONFIG_LOG_DEFAULT_LEVEL=3
CONFIG_PRINTK=y

# Network stack: IPv4 + UDP sockets.
CONFIG_NETWORKING=y
CONFIG_NET_L2_ETHERNET=y
CONFIG_NET_IPV4=y
CONFIG_NET_IPV6=n
CONFIG_NET_UDP=y
CONFIG_NET_TCP=n
CONFIG_NET_SOCKETS=y
CONFIG_NET_CONFIG_SETTINGS=y
CONFIG_NET_CONFIG_NEED_IPV4=y
CONFIG_NET_CONFIG_MY_IPV4_ADDR="192.0.2.1"
CONFIG_NET_CONFIG_MY_IPV4_NETMASK="255.255.255.0"

CONFIG_NET_PKT_RX_COUNT=8
CONFIG_NET_PKT_TX_COUNT=8
CONFIG_NET_BUF_RX_COUNT=16
CONFIG_NET_BUF_TX_COUNT=16

CONFIG_NET_ARP=y
CONFIG_MAIN_STACK_SIZE=4096

# There are multiple IPv4-capable interfaces (two real ENETC plus vnet0).
# The default of 1 lets only ONE interface hold an IPv4 address, which
# NET_CONFIG consumes for the default ENETC, so adding our address to vnet0
# fails. Allow enough IPv4 interfaces/addresses to cover all of them.
CONFIG_NET_IF_MAX_IPV4_COUNT=4
CONFIG_NET_IF_UNICAST_IPV4_ADDR_COUNT=4


# The net stack needs a source of randomness (ephemeral ports, etc).
CONFIG_TEST_RANDOM_GENERATOR=y

# vnet demo: bind socket to vnet0 explicitly (board also has real ENETC ifaces)
CONFIG_NET_INTERFACE_NAME=y
CONFIG_NET_SOCKETS_SOCKOPT_TLS=n
CONFIG_NET_IPV4_ACD=n
```

## boards/frdm_mcxn947_mcxn947_cpu1.overlay
```dts
/*
 * Copyright 2024-2026 NXP
 *
 * SPDX-License-Identifier: Apache-2.0
 */

/ {
	/*
	 * Virtual Ethernet over inter-processor shared memory + MBOX doorbell.
	 * This core (cpu1) is the "remote": it mirrors the ring mapping and
	 * waits for the host to publish the shared block. Both cores see SRAM
	 * at the same address on MCXN947, so reg matches the host's base.
	 */
	vnet0: ethernet@20060000 {
		compatible = "zephyr,ipc-ethernet";
		reg = <0x20060000 0x6100>;
		mboxes = <&mbox 0>, <&mbox 1>;
		mbox-names = "tx", "rx";
		role = "remote";
		local-mac-address = [02 00 5e 00 53 01];
		status = "okay";
	};
};
```

## boards/mcx_n9xx_evk_mcxn947_cpu1.overlay
```dts
/*
 * Copyright 2024-2026 NXP
 *
 * SPDX-License-Identifier: Apache-2.0
 */

/ {
	/*
	 * Virtual Ethernet over inter-processor shared memory + MBOX doorbell.
	 * This core (cpu1) is the "remote". Both cores see SRAM at the same
	 * address on MCXN947, so reg matches the host's base.
	 */
	vnet0: ethernet@20060000 {
		compatible = "zephyr,ipc-ethernet";
		reg = <0x20060000 0x6100>;
		mboxes = <&mbox 0>, <&mbox 1>;
		mbox-names = "tx", "rx";
		role = "remote";
		local-mac-address = [02 00 5e 00 53 01];
		status = "okay";
	};
};
```

## boards/mimxrt1180_evk_mimxrt1189_cm7.overlay
```dts
/*
 * Copyright 2025-2026 NXP
 *
 * SPDX-License-Identifier: Apache-2.0
 */

/ {
	/*
	 * Virtual Ethernet over inter-processor shared memory + MBOX doorbell.
	 * This core (CM7) is the "remote". The CM33 places the shared block in
	 * the top 1 MB of hyperram0; from the CM7 the same physical HyperRAM is
	 * seen at 0x04000000, so the shared block is at 0x04700000.
	 */
	vnet0: ethernet@4700000 {
		compatible = "zephyr,ipc-ethernet";
		reg = <0x04700000 0x6100>;
		mboxes = <&mbox1_b 0>, <&mbox1_b 1>;
		mbox-names = "tx", "rx";
		role = "remote";
		local-mac-address = [02 00 5e 00 53 01];
		status = "okay";
	};
};

/*
 * hyperram0 is disabled in the CM7 device tree by default; enable it here and
 * size it to cover the shared window so the driver can access the block.
 */
&hyperram0 {
	reg = <0x04000000 DT_SIZE_M(8)>;
	status = "okay";
};
```

## src/main.c
```c
/*
 * Copyright (c) 2021 Carlo Caione <ccaione@baylibre.com>
 * Copyright 2026 NXP
 *
 * SPDX-License-Identifier: Apache-2.0
 */

#include <zephyr/kernel.h>
#include <zephyr/sys/printk.h>

/*
 * Virtual network device demo (remote side).
 *
 * The vnet0 interface is provided by the in-tree zephyr,ipc-ethernet driver
 * (drivers/ethernet/eth_ipc.c): UDP datagrams sent to the CM33 host's
 * address cross the shared-memory ring signalled by the MBOX doorbell.
 */
#include "vnet_demo.h"

#define VNET_SELF_ADDR CONFIG_NET_CONFIG_MY_IPV4_ADDR
/* Defaults to the host (192.0.2.2); override CONFIG_VNET_DEMO_PEER_ADDR to
 * target an off-chip host (e.g. a PC at 192.0.2.10) reachable through the
 * host core's vnet0<->Ethernet bridge. This may be a comma-separated list,
 * e.g. "192.0.2.2,192.0.2.10" to send to both the host core and the PC.
 */
#define VNET_PEER_ADDR CONFIG_VNET_DEMO_PEER_ADDR


int main(void)
{
	printk("Hello from REMOTE - %s\n", CONFIG_BOARD_TARGET);

	vnet_demo_run(VNET_SELF_ADDR, VNET_PEER_ADDR, CONFIG_BOARD_TARGET);



	return 0;
}
```
