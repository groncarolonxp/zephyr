## CMakeLists.txt
```
#
# Copyright (c) 2021 Carlo Caione <ccaione@baylibre.com>
# Copyright 2023-2026 NXP
# Copyright 2025 Ezurio LLC
#
# SPDX-License-Identifier: Apache-2.0
#

cmake_minimum_required(VERSION 3.20.0)

find_package(Zephyr REQUIRED HINTS $ENV{ZEPHYR_BASE})

set(REMOTE_ZEPHYR_DIR ${CMAKE_CURRENT_BINARY_DIR}/../remote/zephyr)

if(CONFIG_BOARD_MIMXRT1180_EVK_MIMXRT1189_CM33 OR
   CONFIG_BOARD_FRDM_MCXN947_MCXN947_CPU0 OR
   CONFIG_BOARD_MCX_N9XX_EVK_MCXN947_CPU0)
  message(STATUS "${BOARD}/${BOARD_QUALIFIERS} compile as Main in this sample")

else()
  message(FATAL_ERROR "${BOARD}/${BOARD_QUALIFIERS} is not supported for this sample")
endif()

project(mbox_ipc)

enable_language(C ASM)

if(CONFIG_INCLUDE_REMOTE_DIR)
  target_include_directories(zephyr_interface
    INTERFACE ${REMOTE_ZEPHYR_DIR}/include/public)
endif()

target_sources(app PRIVATE src/main.c)


# The virtual Ethernet link is now provided by the in-tree
# zephyr,ipc-ethernet driver (drivers/ethernet/eth_ipc.c), enabled from the
# vnet0 devicetree node. The sample only builds the UDP demo on top of it.
if(CONFIG_VNET)
  target_sources(app PRIVATE
    ${CMAKE_CURRENT_SOURCE_DIR}/common/vnet_demo.c)
  target_include_directories(app PRIVATE ${CMAKE_CURRENT_SOURCE_DIR}/common)
endif()

if(CONFIG_VNET_BRIDGE)
  target_sources(app PRIVATE ${CMAKE_CURRENT_SOURCE_DIR}/common/vnet_bridge.c)
endif()
```

## Kconfig
```
# Copyright 2023 NXP
#
# SPDX-License-Identifier: Apache-2.0

source "Kconfig.zephyr"
rsource "common/Kconfig.vnet"

config INCLUDE_REMOTE_DIR
	bool "Include remote core header directory"
	help
	  Include remote build header files. Can be used if primary image
	  needs to be aware of size or base address of secondary image

config TX_ENABLED
	bool "TX enabled"
	default y
	help
	  Enable TX

config RX_ENABLED
	bool "RX enabled"
	default y
	help
	  Enable RX
```

## Kconfig.sysbuild
```
# Copyright 2023 Nordic Semiconductor ASA
# Copyright 2023-2025 NXP
# Copyright 2025 Ezurio LLC
#
# SPDX-License-Identifier: Apache-2.0

source "share/sysbuild/Kconfig"

config REMOTE_BOARD
	string "Remote board"
	default "mimxrt1180_evk/mimxrt1189/cm7" if $(BOARD) = "mimxrt1180_evk"
	default "frdm_mcxn947/mcxn947/cpu1" if $(BOARD) = "frdm_mcxn947"
	default "mcx_n9xx_evk/mcxn947/cpu1" if $(BOARD) = "mcx_n9xx_evk"
```

## sample.yaml
```
sample:
  name: Virtual network device (cross-core vnet)
common:
  sysbuild: true
  tags: net mbox
  timeout: 30
tests:
  sample.drivers.vnet.vnet:
    filter: dt_compat_enabled("zephyr,ipc-ethernet")
    platform_allow:
      - mimxrt1180_evk/mimxrt1189/cm33
      - frdm_mcxn947/mcxn947/cpu0
      - mcx_n9xx_evk/mcxn947/cpu0
    integration_platforms:
      - frdm_mcxn947/mcxn947/cpu0
    harness: console
    harness_config:
      type: multi_line
      ordered: false
      regex:
        - "VNET: \\[TX\\] sent .*"
        - "VNET: \\[RX\\] received .*"
```

## prj.conf
```kconfig
CONFIG_PRINTK=y
CONFIG_MBOX=y

# The virtual Ethernet link is provided by the in-tree zephyr,ipc-ethernet
# driver (CONFIG_ETH_IPC), instantiated from the vnet0 devicetree node in each
# board overlay. The driver role, shared-block address, mailbox channels, plus
# the full network stack are configured per-board under boards/.
```

## boards/mcx_n9xx_evk_mcxn947_cpu0.conf
```kconfig
CONFIG_SECOND_CORE_MCUX=y

# Virtual Ethernet over shared memory + MBOX doorbell, provided by the in-tree
# zephyr,ipc-ethernet driver (CONFIG_ETH_IPC). This core (cpu0) is the "host":
# the role, shared-block address and mailbox channels come from the vnet0
# devicetree node in the board overlay.
CONFIG_ETH_IPC=y

# Sample UDP demo on top of vnet0.
CONFIG_VNET=y
# Bridge vnet0 with the real on-board Ethernet so the remote core (cpu1) can
# reach an off-chip host (e.g. a PC at 192.0.2.10). With this set, cpu0 runs
# the bridge in addition to the UDP demo.
CONFIG_VNET_BRIDGE=y

CONFIG_MBOX=y
CONFIG_NET_ETHERNET_BRIDGE=y

# Logging: synchronous so the vnet driver messages print immediately.
CONFIG_LOG=y
CONFIG_LOG_MODE_IMMEDIATE=y
CONFIG_LOG_DEFAULT_LEVEL=3
CONFIG_PRINTK=y
CONFIG_CONSOLE=y
CONFIG_UART_CONSOLE=y

# Network stack: IPv4 + UDP sockets.
CONFIG_NETWORKING=y
CONFIG_NET_L2_ETHERNET=y
CONFIG_NET_IPV4=y
CONFIG_NET_IPV6=n
CONFIG_NET_UDP=y
CONFIG_NET_TCP=n
CONFIG_NET_SOCKETS=y
CONFIG_NET_CONFIG_SETTINGS=y
CONFIG_NET_CONFIG_NEED_IPV4=y
CONFIG_NET_CONFIG_MY_IPV4_ADDR="192.0.2.2"
CONFIG_NET_CONFIG_MY_IPV4_NETMASK="255.255.255.0"

# The on-board ENET MAC is left enabled (so a future bridge on this core can
# forward vnet0 traffic out to the real network). ENET reserves RX net_pkt /
# net_buf descriptors at init, so the shared pools must be large enough to
# serve BOTH the real ENET and vnet0 - otherwise vnet0's RX allocation is
# starved and the driver logs "RX alloc failed". Size the pools generously.
CONFIG_NET_PKT_RX_COUNT=16
CONFIG_NET_PKT_TX_COUNT=16
CONFIG_NET_BUF_RX_COUNT=32
CONFIG_NET_BUF_TX_COUNT=32


CONFIG_NET_ARP=y
CONFIG_MAIN_STACK_SIZE=4096

# There are multiple IPv4-capable interfaces (real ENET plus vnet0). The
# default of 1 lets only ONE interface hold an IPv4 address, which NET_CONFIG
# consumes for the default ENET, so adding our address to vnet0 fails. Allow
# enough IPv4 interfaces/addresses to cover all of them.
CONFIG_NET_IF_MAX_IPV4_COUNT=4
CONFIG_NET_IF_UNICAST_IPV4_ADDR_COUNT=4

# The net stack needs a source of randomness (ephemeral ports, etc).
CONFIG_TEST_RANDOM_GENERATOR=y

# vnet demo: bind socket to vnet0 explicitly (board also has a real ENET iface)
CONFIG_NET_INTERFACE_NAME=y
CONFIG_NET_SOCKETS_SOCKOPT_TLS=n
CONFIG_NET_IPV4_ACD=n
```

## boards/mimxrt1180_evk_mimxrt1189_cm33.conf
```kconfig
CONFIG_SECOND_CORE_MCUX=y
CONFIG_INCLUDE_REMOTE_DIR=y

# Virtual Ethernet over shared memory + MBOX doorbell, provided by the in-tree
# zephyr,ipc-ethernet driver (CONFIG_ETH_IPC). This core (CM33) is the "host":
# the role, shared-block address and mailbox channels come from the vnet0
# devicetree node in the board overlay.
CONFIG_ETH_IPC=y

# Sample UDP demo on top of vnet0.
CONFIG_VNET=y

CONFIG_MBOX=y

# Logging: enable so the vnet driver LOG_INF/LOG_WRN messages are printed.
# Synchronous mode prints immediately (no deferred logging thread) which is
# what we want while bringing up the cross-core link.
CONFIG_LOG=y
CONFIG_LOG_MODE_IMMEDIATE=y
CONFIG_LOG_DEFAULT_LEVEL=3
CONFIG_PRINTK=y
CONFIG_CONSOLE=y
CONFIG_UART_CONSOLE=y


# Network stack: IPv4 + UDP sockets.
CONFIG_NETWORKING=y
CONFIG_NET_L2_ETHERNET=y
CONFIG_NET_IPV4=y
CONFIG_NET_IPV6=n
CONFIG_NET_UDP=y
CONFIG_NET_TCP=n
CONFIG_NET_SOCKETS=y
CONFIG_NET_CONFIG_SETTINGS=y
CONFIG_NET_CONFIG_NEED_IPV4=y
CONFIG_NET_CONFIG_MY_IPV4_ADDR="192.0.2.2"
CONFIG_NET_CONFIG_MY_IPV4_NETMASK="255.255.255.0"

CONFIG_NET_PKT_RX_COUNT=8
CONFIG_NET_PKT_TX_COUNT=8
CONFIG_NET_BUF_RX_COUNT=16
CONFIG_NET_BUF_TX_COUNT=16

CONFIG_NET_ARP=y
CONFIG_MAIN_STACK_SIZE=4096

# There are multiple IPv4-capable interfaces (two real ENETC plus vnet0).
# The default of 1 lets only ONE interface hold an IPv4 address, which
# NET_CONFIG consumes for the default ENETC, so adding our address to vnet0
# fails. Allow enough IPv4 interfaces/addresses to cover all of them.
CONFIG_NET_IF_MAX_IPV4_COUNT=4
CONFIG_NET_IF_UNICAST_IPV4_ADDR_COUNT=4


# The net stack needs a source of randomness (ephemeral ports, etc).
CONFIG_TEST_RANDOM_GENERATOR=y

# vnet demo: bind socket to vnet0 explicitly (board also has real ENETC ifaces)
CONFIG_NET_INTERFACE_NAME=y
CONFIG_NET_SOCKETS_SOCKOPT_TLS=n
CONFIG_NET_IPV4_ACD=n
```

## boards/frdm_mcxn947_mcxn947_cpu0.overlay
```dts
/*
 * Copyright 2024-2026 NXP
 *
 * SPDX-License-Identifier: Apache-2.0
 */

/ {
	/*
	 * Virtual Ethernet over inter-processor shared memory + MBOX doorbell.
	 * This core (cpu0) is the "host": it initialises and publishes the
	 * shared block. The block lives in sramh (0x20060000, 32 KB) which is
	 * not allocated to either core; both cores see SRAM at the same
	 * address on MCXN947, so host and remote use the same reg base.
	 */
	vnet0: ethernet@20060000 {
		compatible = "zephyr,ipc-ethernet";
		reg = <0x20060000 0x6100>;
		mboxes = <&mbox 1>, <&mbox 0>;
		mbox-names = "tx", "rx";
		role = "host";
		local-mac-address = [02 00 5e 00 53 02];
		status = "okay";
	};
};
```

## boards/mcx_n9xx_evk_mcxn947_cpu0.overlay
```dts
/*
 * Copyright 2024-2026 NXP
 *
 * SPDX-License-Identifier: Apache-2.0
 */

/ {
	/*
	 * Virtual Ethernet over inter-processor shared memory + MBOX doorbell.
	 * This core (cpu0) is the "host". The shared block lives in sramh
	 * (0x20060000, 32 KB); both cores see SRAM at the same address.
	 */
	vnet0: ethernet@20060000 {
		compatible = "zephyr,ipc-ethernet";
		reg = <0x20060000 0x6100>;
		mboxes = <&mbox 1>, <&mbox 0>;
		mbox-names = "tx", "rx";
		role = "host";
		local-mac-address = [02 00 5e 00 53 02];
		status = "okay";
	};
};
```

## boards/mimxrt1180_evk_mimxrt1189_cm33.overlay
```dts
/*
 * Copyright 2025-2026 NXP
 *
 * SPDX-License-Identifier: Apache-2.0
 */

/ {
	/*
	 * Virtual Ethernet over inter-processor shared memory + MBOX doorbell.
	 * This core (CM33) is the "host". The shared block lives in the top
	 * 1 MB of hyperram0; from the CM33 that window is at 0x14700000.
	 */
	vnet0: ethernet@14700000 {
		compatible = "zephyr,ipc-ethernet";
		reg = <0x14700000 0x6100>;
		mboxes = <&mbox1_a 1>, <&mbox1_a 0>;
		mbox-names = "tx", "rx";
		role = "host";
		local-mac-address = [02 00 5e 00 53 02];
		status = "okay";
	};
};

/*
 * Shrink hyperram0 (the CM33 SRAM) from 8 MB to 7 MB so the top 1 MB window
 * at 0x14700000 is left unused by Zephyr and can hold the vnet shared block.
 * The CM7 sees the same physical window at 0x04700000.
 */
&hyperram0 {
	reg = <0x14000000 DT_SIZE_M(7)>;
};
```

## src/main.c
```c
/*
 * Copyright (c) 2021 Carlo Caione <ccaione@baylibre.com>
 * Copyright 2026 NXP
 *
 * SPDX-License-Identifier: Apache-2.0
 */

#include <zephyr/kernel.h>
#include <zephyr/sys/printk.h>

/*
 * Virtual network device demo (host side).
 *
 * The vnet0 interface is provided by the in-tree zephyr,ipc-ethernet driver
 * (drivers/ethernet/eth_ipc.c): UDP datagrams sent to the remote core's
 * address cross the shared-memory ring signalled by the MBOX doorbell.
 *
 * CONFIG_VNET_BRIDGE: instead of running the UDP demo, this core L2-bridges
 * vnet0 with the real on-board Ethernet so the remote core can reach an
 * off-chip host (e.g. a PC) through this core.
 */
#include "vnet_demo.h"

#define VNET_HOST_ADDR CONFIG_NET_CONFIG_MY_IPV4_ADDR
/* CONFIG_VNET_DEMO_PEER_ADDR may be a comma-separated list, e.g.
 * "192.0.2.1,192.0.2.10" to send to both the remote core (cpu1) and an
 * off-chip PC each cycle.
 */
#define VNET_PEER_ADDR CONFIG_VNET_DEMO_PEER_ADDR


int main(void)
{
	printk("Hello from HOST - %s\n", CONFIG_BOARD_TARGET);

#if defined(CONFIG_VNET_BRIDGE)
	/* Set up the vnet0 <-> Ethernet L2 bridge first so the remote core
	 * can reach an off-chip host. vnet_bridge_run() returns once the
	 * bridge is up, after which we ALSO run the UDP demo on this core so
	 * cpu0 is a full endpoint: it assigns 192.0.2.2 to vnet0, starts its
	 * own RX thread (to print CPU1->CPU0 and PC->CPU0 datagrams), and
	 * sends to its configured peers (CPU1 and the PC).
	 */
	vnet_bridge_run();

	/* vnet0 is now enslaved to the L2 bridge, so a socket bound to vnet0
	 * would never receive frames destined to this core. Bind the local
	 * UDP endpoint (IP + socket + RX) to the bridge interface instead so
	 * cpu0 can both send AND receive (CPU1->CPU0 and PC->CPU0).
	 */
	vnet_demo_set_iface(vnet_bridge_get_iface());
#endif

	vnet_demo_run(VNET_HOST_ADDR, VNET_PEER_ADDR, CONFIG_BOARD_TARGET);


	return 0;

}
```
