## CMakeLists.txt
```
# Copyright 2026 NXP
# SPDX-License-Identifier: Apache-2.0

cmake_minimum_required(VERSION 3.20.0)

find_package(Zephyr REQUIRED HINTS $ENV{ZEPHYR_BASE})
project(ipc_eth_bridge)

target_sources(app PRIVATE src/main.c)
```

## Kconfig.sysbuild
```
# Copyright 2026 NXP
#
# SPDX-License-Identifier: Apache-2.0

source "share/sysbuild/Kconfig"

config REMOTE_BOARD
	string "Remote board"
	default "frdm_mcxn947/mcxn947/cpu1" if $(BOARD) = "frdm_mcxn947"
	default "mcx_n9xx_evk/mcxn947/cpu1" if $(BOARD) = "mcx_n9xx_evk"
	help
	  The board target of the remote (cpu1) image. cpu0 runs this bridge
	  trampoline; the remote core runs the stock application selected by
	  REMOTE_APP_SOURCE_DIR below.

config REMOTE_APP_SOURCE_DIR
	string "Remote application source directory"
	default "${ZEPHYR_BASE}/samples/net/sockets/echo_server"
	help
	  Absolute path to the stock Zephyr application built for the remote
	  (cpu1) core. Defaults to the unmodified sockets/echo_server sample,
	  which answers on both UDP and TCP port 4242 and ships an
	  ipc-ethernet (vnet0) board overlay for cpu1.
```

## sample.yaml
```
sample:
  name: IPC Ethernet host-side bridge (trampoline)
  description: >
    Host-core trampoline that L2-bridges the IPC virtual Ethernet (vnet0,
    provided by the zephyr,ipc-ethernet driver) with the on-board real
    Ethernet, so a stock networking app on the remote core can reach an
    off-chip host. Pairs with a "remote" ipc-ethernet instance on the other
    core (e.g. a stock samples/net/sockets/echo built for that core).
tests:
  sample.net.ipc_eth_bridge:
    build_only: true
    platform_allow:
      - frdm_mcxn947/mcxn947/cpu0
    tags: net ethernet ipc
    depends_on: mbox
```

## sysbuild.conf
```
# Copyright 2026 NXP
# SPDX-License-Identifier: Apache-2.0
#
# Sysbuild configuration for the ipc_eth_bridge sample (cpu0 host). This
# selects which stock Zephyr application is built as the "remote" (cpu1)
# image over the IPC virtual Ethernet (vnet0).
#
# Toggle the remote app by commenting/uncommenting one of the lines below.
# The default (if this file is absent or both are commented) is the stock
# sockets/echo_server, as declared in Kconfig.sysbuild.
#
# - echo_server: answers on UDP and TCP port 4242 (functional / loopback test)
# - zperf:       throughput benchmark server (stress / performance test)

# Remote = echo_server (default behaviour).
#SB_CONFIG_REMOTE_APP_SOURCE_DIR="${ZEPHYR_BASE}/samples/net/sockets/echo_server"

# Remote = zperf (uncomment to run the throughput test on cpu1).
SB_CONFIG_REMOTE_APP_SOURCE_DIR="${ZEPHYR_BASE}/samples/net/zperf"
```

## prj.conf
```kconfig
# Copyright 2026 NXP
# SPDX-License-Identifier: Apache-2.0

CONFIG_NETWORKING=y
CONFIG_NET_L2_ETHERNET=y
CONFIG_NET_ETHERNET_BRIDGE=y

# The ipc-ethernet driver (vnet0) is instantiated from the board overlay.
CONFIG_ETH_IPC=y
CONFIG_MBOX=y

CONFIG_NET_IPV4=y
CONFIG_NET_IPV6=n

CONFIG_LOG=y
CONFIG_LOG_MODE_IMMEDIATE=y
CONFIG_PRINTK=y

CONFIG_MAIN_STACK_SIZE=4096
```

## boards/frdm_mcxn947_mcxn947_cpu0.conf
```kconfig
# Copyright 2026 NXP
# SPDX-License-Identifier: Apache-2.0

CONFIG_SECOND_CORE_MCUX=y

# Give the shared net_buf/net_pkt pools headroom: the real ENET also draws on
# them, and starving vnet0's RX allocation shows up as "RX alloc failed".
CONFIG_NET_PKT_RX_COUNT=16
CONFIG_NET_PKT_TX_COUNT=16
CONFIG_NET_BUF_RX_COUNT=32
CONFIG_NET_BUF_TX_COUNT=32

CONFIG_NET_ARP=y
```

## boards/frdm_mcxn947_mcxn947_cpu0.overlay
```dts
/*
 * Copyright 2026 NXP
 *
 * SPDX-License-Identifier: Apache-2.0
 *
 * Host-side (cpu0) instance of the IPC virtual Ethernet. This core is the
 * "host": it initialises and publishes the shared block. It runs the bridge
 * trampoline (see src/main.c) rather than a socket app, forwarding vnet0 <->
 * the real on-board Ethernet so a stock app on cpu1 can reach an off-chip PC.
 */

/ {
	vnet0: ethernet@20060000 {
		compatible = "zephyr,ipc-ethernet";
		reg = <0x20060000 0x6100>;
		mboxes = <&mbox 1>, <&mbox 0>;
		mbox-names = "tx", "rx";
		role = "host";
		local-mac-address = [02 00 5e 00 53 02];
		status = "okay";
	};
};
```

## src/main.c
```c
/*
 * Copyright 2026 NXP
 *
 * SPDX-License-Identifier: Apache-2.0
 *
 * Trampoline / bridge app for the host core (cpu0).
 *
 * This is the "simple trampoline" counterpart to running a stock networking
 * sample on the remote core: it does NOT run any socket application itself.
 * It only L2-bridges the IPC virtual Ethernet (vnet0, provided by the
 * zephyr,ipc-ethernet driver) with the on-board real Ethernet, so a stock
 * app on the remote core (e.g. samples/net/sockets/echo) can reach an
 * off-chip host (e.g. a PC) through this core's Ethernet port.
 *
 * All the "magic" (shared-memory ring, MBOX doorbell, handshake, carrier)
 * lives in the driver; this app is just the forwarding glue.
 */

#include <zephyr/kernel.h>
#include <zephyr/sys/printk.h>
#include <zephyr/net/net_if.h>
#include <zephyr/net/ethernet.h>
#include <zephyr/net/ethernet_bridge.h>
#include <zephyr/device.h>

/* The virtual interface is bound to the "zephyr,ipc-ethernet" DT node. */
#define VNET_NODE DT_NODELABEL(vnet0)

static struct net_if *bridge_iface;

static void bridge_find_cb(struct eth_bridge_iface_context *br, void *user_data)
{
	ARG_UNUSED(user_data);

	if (bridge_iface == NULL) {
		bridge_iface = br->iface;
	}
}

/* Return the real (non-virtual) Ethernet interface: not vnet0, not the
 * bridge interface itself.
 */
static struct net_if *find_real_eth(struct net_if *vnet0, struct net_if *bridge)
{
	STRUCT_SECTION_FOREACH(net_if, iface) {
		if (iface == vnet0 || iface == bridge) {
			continue;
		}
		if (net_if_l2(iface) != &NET_L2_GET_NAME(ETHERNET)) {
			continue;
		}
		return iface;
	}

	return NULL;
}

int main(void)
{
	const struct device *vdev = DEVICE_DT_GET(VNET_NODE);
	struct net_if *vnet0;
	struct net_if *eth;
	int ret;

	printk("IPC-ETH bridge (host core) starting\n");

	if (!device_is_ready(vdev)) {
		printk("BRIDGE: vnet0 device not ready\n");
		return 0;
	}

	vnet0 = net_if_lookup_by_dev(vdev);
	if (vnet0 == NULL) {
		printk("BRIDGE: no net_if bound to vnet0\n");
		return 0;
	}

	/* Wait until vnet0 is operational (peer handshake done). */
	if (!net_if_is_admin_up(vnet0)) {
		(void)net_if_up(vnet0);
	}
	for (int i = 0; i < 200 && !net_if_is_up(vnet0); i++) {
		if (!net_if_is_admin_up(vnet0)) {
			(void)net_if_up(vnet0);
		}
		k_sleep(K_MSEC(50));
	}

	net_eth_bridge_foreach(bridge_find_cb, NULL);
	if (bridge_iface == NULL) {
		printk("BRIDGE: no bridge interface available\n");
		return 0;
	}

	eth = find_real_eth(vnet0, bridge_iface);
	if (eth == NULL) {
		printk("BRIDGE: no real Ethernet interface found\n");
		return 0;
	}

	if (!net_if_is_admin_up(eth)) {
		(void)net_if_up(eth);
	}

	printk("BRIDGE: bridging vnet0 (iface %d) with eth (iface %d) via "
	       "bridge iface %d\n",
	       net_if_get_by_iface(vnet0), net_if_get_by_iface(eth),
	       net_if_get_by_iface(bridge_iface));

	ret = eth_bridge_iface_add(bridge_iface, vnet0);
	if (ret < 0) {
		printk("BRIDGE: add vnet0 failed (%d)\n", ret);
		return 0;
	}

	ret = eth_bridge_iface_add(bridge_iface, eth);
	if (ret < 0) {
		printk("BRIDGE: add eth failed (%d)\n", ret);
		return 0;
	}

	(void)net_if_up(bridge_iface);
	printk("BRIDGE: up - vnet0 <-> eth L2 forwarding active\n");

	return 0;
}
```
