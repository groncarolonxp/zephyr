/*
 * Custom overlay for MIMXRT1180-EVK board
 * Adds Arduino header support and enables SPI/I2C
 */

#include <zephyr/dt-bindings/gpio/arduino-header-r3.h>

/ {
	arduino_header: connector {
		compatible = "arduino-header-r3";
		#gpio-cells = <2>;
		gpio-map-mask = <0xffffffff 0xffffffc0>;
		gpio-map-pass-thru = <0 0x3f>;
		gpio-map = <ARDUINO_HEADER_R3_D0 0 &gpio1 9 0>,
			   <ARDUINO_HEADER_R3_D1 0 &gpio1 8 0>,
			   <ARDUINO_HEADER_R3_D2 0 &gpio4 15 0>,
			   <ARDUINO_HEADER_R3_D3 0 &gpio4 6 0>,
			   <ARDUINO_HEADER_R3_D4 0 &gpio4 12 0>,
			   <ARDUINO_HEADER_R3_D5 0 &gpio4 13 0>,
			   <ARDUINO_HEADER_R3_D6 0 &gpio4 7 0>,
			   <ARDUINO_HEADER_R3_D7 0 &gpio4 8 0>,
			   <ARDUINO_HEADER_R3_D8 0 &gpio4 3 0>,
			   <ARDUINO_HEADER_R3_D9 0 &gpio4 9 0>,
			   <ARDUINO_HEADER_R3_D10 0 &gpio5 4 0>,    /* GPIO_SD_B1_00 - SPI CS */
			   <ARDUINO_HEADER_R3_D11 0 &gpio5 6 0>,    /* GPIO_SD_B1_02 - SPI MOSI */
			   <ARDUINO_HEADER_R3_D12 0 &gpio5 7 0>,    /* GPIO_SD_B1_03 - SPI MISO */
			   <ARDUINO_HEADER_R3_D13 0 &gpio5 5 0>,    /* GPIO_SD_B1_01 - SPI SCK */
			   <ARDUINO_HEADER_R3_D14 0 &gpio4 17 0>,
			   <ARDUINO_HEADER_R3_D15 0 &gpio4 16 0>,
			   <ARDUINO_HEADER_R3_A0 0 &gpio4 10 0>,
			   <ARDUINO_HEADER_R3_A1 0 &gpio4 11 0>,
			   <ARDUINO_HEADER_R3_A2 0 &gpio4 4 0>,
			   <ARDUINO_HEADER_R3_A3 0 &gpio4 5 0>,
			   <ARDUINO_HEADER_R3_A4 0 &gpio4 17 0>,
			   <ARDUINO_HEADER_R3_A5 0 &gpio4 16 0>;
	};
};

/* Arduino SPI - mapped to lpspi3 */
arduino_spi: &lpspi3 {
	status = "okay";
};

/* Arduino I2C - mapped to lpi2c2 */
arduino_i2c: &lpi2c2 {
	status = "okay";
};
